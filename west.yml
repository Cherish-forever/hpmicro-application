## west.yml
```yaml
# Copyright (c) 2021 Nordic Semiconductor ASA
# SPDX-License-Identifier: Apache-2.0

manifest:
  self:
    west-commands: scripts/west-commands.yml

  remotes:
    - name: hpmicro
      url-base: https://github.com/hpmicro

  projects:
    - name: zephyr
      remote: hpmicro
      revision: "feature/add_hpmicro_device_support_ver3.1rc"
      import: true
```
